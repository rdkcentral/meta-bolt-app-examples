## conf/layer.conf
```bitbake
BBPATH .= ":${LAYERDIR}"

BBFILES += "${LAYERDIR}/recipes-*/*/*.bb \
            ${LAYERDIR}/recipes-*/*/*.bbappend \
            ${LAYERDIR}/meta/recipes-*/*/*.bbappend"

BBFILE_COLLECTIONS += "meta-bolt-app-examples"
BBFILE_PATTERN_meta-bolt-app-examples = "^${LAYERDIR}/"
BBFILE_PRIORITY_meta-bolt-app-examples = "10"

LAYERDEPENDS_meta-bolt-app-examples = "bolt-base"
LAYERSERIES_COMPAT_meta-bolt-app-examples = "kirkstone"
```
